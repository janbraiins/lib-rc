## Kconfig
```kconfig
menu "lib-rc"
config LIB_RC_RC_CHANNELS_MAX_COUNT
       int "Maximum number of RC channels"
       default 12

config LIB_RC_MULTIPLEX
       bool "Multiplex radios"
       default n
       ---help---
          Support for decoding serial data with channel values from
	  the transmitter module (not PPM support!)

config LIB_RC_JETI
       bool "JETI radios"
       default n
       ---help---
          Support for JETI radios

config LIB_RC_JETI_UDI
       bool "UDI protocol"
       depends on LIB_RC_JETI
       default n
       ---help---
          Support for decoding serial RC channel data in UDI format.

config LIB_RC_SERVO
       bool "Servo control"
       default n
       ---help---
          Support for servo control algorithms
endmenu
```
